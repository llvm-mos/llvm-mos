/* mos-c64.ld */
__stack_size = 1k;

MEMORY
{
	ram (wxa!r) : ORIGIN =  0x7ff, LENGTH = 0x9fff - 0x7ff
}

REGION_ALIAS("REGION_LOAD_ADDRESS", ram);
REGION_ALIAS("REGION_INIT", ram);
REGION_ALIAS("REGION_TEXT", ram);
REGION_ALIAS("REGION_RODATA", ram);
REGION_ALIAS("REGION_INIT_ARRAY", ram);
REGION_ALIAS("REGION_CTORS", ram);
REGION_ALIAS("REGION_DATA", ram);
REGION_ALIAS("REGION_TDATA", ram);
REGION_ALIAS("REGION_BSS", ram);

INCLUDE mos-picolibc.ld

